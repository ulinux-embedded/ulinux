## mainfs-buildroot/package/ulinux-device-daemon/Config.in
```kconfig
config BR2_PACKAGE_ULINUX_DEVICE_DAEMON
        bool "ulinux-device-daemon"
        depends on BR2_PACKAGE_NODEJS
        help
          The Device Daemon component of uLinux. It is responsible for updating the device, among other things.

          https://github.com/ulinux-embedded/ulinux-device-daemon

comment "ulinuxdd depends on nodejs"
        depends on !BR2_PACKAGE_NODEJS
```
